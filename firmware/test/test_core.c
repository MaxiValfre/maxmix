/*
 * Host-side tests for the firmware's portable C core.
 * Build & run: make -C firmware test
 * Protocol cases are checked against bytes generated by the Rust crate
 * (vectors.h), proving host and firmware agree on the wire format.
 */
#include <stdio.h>
#include <string.h>

#include "../MaxMix/mm_light.h"
#include "../MaxMix/mm_proto.h"
#include "vectors.h"

static int failures = 0;
static int checks = 0;
#define CHECK(cond)                                                     \
    do {                                                                \
        checks++;                                                       \
        if (!(cond)) {                                                  \
            failures++;                                                 \
            fprintf(stderr, "FAIL %s:%d: %s\n", __FILE__, __LINE__, #cond); \
        }                                                               \
    } while (0)

static int decode_one(const uint8_t *bytes, size_t n, mm_frame_t *f) {
    mm_decoder_t d;
    mm_decoder_init(&d);
    for (size_t i = 0; i < n; i++) mm_decoder_push(&d, bytes[i]);
    return mm_decoder_poll(&d, f);
}

#define DECODE(v, f) decode_one((v), sizeof(v), (f))
#define SAME(buf, n, v) ((n) == sizeof(v) && memcmp((buf), (v), sizeof(v)) == 0)

static void test_crc(void) {
    CHECK(mm_crc8((const uint8_t *)"123456789", 9) == 0xA1);
    CHECK(mm_crc8(0, 0) == 0);
}

static void test_decode_host_frames(void) {
    mm_frame_t f;
    uint8_t a, b, c;

    CHECK(DECODE(V_HELLO, &f) && mm_parse_hello(&f, &a) && a == 2);
    CHECK(DECODE(V_PING, &f) && f.type == MM_T_PING && f.len == 0);
    CHECK(DECODE(V_SESSION_INFO, &f) && mm_parse_session_info(&f, &a, &b, &c));
    CHECK(a == 2 && b == 1 && c == 3);

    mm_session_t s;
    CHECK(DECODE(V_SESSION_DATA, &f) && mm_parse_session_data(&f, &s));
    CHECK(s.slot == MM_SLOT_CURRENT);
    CHECK(s.volume.id == 19 && s.volume.volume == 75 && s.volume.is_muted && !s.volume.is_default);
    CHECK(strcmp(s.name, "Cafe Spotify") == 0); /* host transliterated + terminated */

    mm_volume_t v;
    CHECK(DECODE(V_VOLUME_SET, &f) && mm_parse_volume_set(&f, &a, &v));
    CHECK(a == MM_SLOT_NEXT && v.id == 5 && v.is_default && v.volume == 100 && !v.is_muted);

    mm_lighting_t l;
    CHECK(DECODE(V_LIGHTING, &f) && mm_parse_lighting(&f, &l));
    CHECK(l.mode == MM_LIGHT_PULSE && l.speed == 7 && l.idle_mode == MM_LIGHT_FADE);
    CHECK(l.color_count == 3);
    CHECK(l.colors[0].b == 32 && l.colors[1].g == 128 && l.colors[1].b == 255);
    CHECK(l.colors[2].r == 255 && l.colors[2].b == 160);
    CHECK(l.idle_timeout_s == 30);
    CHECK(l.volume_min.g == 255 && l.volume_min.b == 64 && l.volume_max.r == 255 && l.volume_max.g == 0);

    mm_devcfg_t dc;
    CHECK(DECODE(V_DEVICE_CONFIG, &f) && mm_parse_devcfg(&f, &dc));
    CHECK(dc.acceleration == 60 && dc.sleep_after_s == 10 && dc.continuous_scroll && dc.ring_reversed);
    CHECK(dc.dim_after_s == 20);
}

static void test_encode_device_frames(void) {
    uint8_t out[MM_FRAME_MAX];
    uint8_t n;
    mm_volume_t v = {19, 0, 42, 1};

    n = mm_encode_hello_ack(2, 0, 1, out);
    CHECK(SAME(out, n, V_HELLO_ACK));
    n = mm_encode_pong(out);
    CHECK(SAME(out, n, V_PONG));
    n = mm_encode_volume_change(MM_SLOT_CURRENT, &v, out);
    CHECK(SAME(out, n, V_VOLUME_CHANGE));
    n = mm_encode_session_request(1, out);
    CHECK(SAME(out, n, V_SESSION_REQUEST));
    n = mm_encode_button(2, out);
    CHECK(SAME(out, n, V_BUTTON));
}

static void test_resync(void) {
    mm_decoder_t d;
    mm_frame_t f;
    int frames = 0, last_type = -1;
    mm_decoder_init(&d);
    for (size_t i = 0; i < sizeof(V_NOISY_THEN_PING); i++) {
        mm_decoder_push(&d, V_NOISY_THEN_PING[i]);
        while (mm_decoder_poll(&d, &f)) {
            frames++;
            last_type = f.type;
        }
    }
    CHECK(frames == 1);          /* corrupted frame never surfaces */
    CHECK(last_type == MM_T_PING); /* the valid one does */
}

static void test_rejects_wrong_type_or_length(void) {
    mm_frame_t f;
    uint8_t a;
    CHECK(DECODE(V_PING, &f) && !mm_parse_hello(&f, &a));
    f.type = MM_T_HELLO;
    f.len = 2;
    CHECK(!mm_parse_hello(&f, &a));
}

static void test_lighting(void) {
    mm_lighting_t l = {MM_LIGHT_STATIC, 5, 2, {{0, 0, 0}, {255, 255, 255}}, MM_LIGHT_PULSE, 30,
                       {0, 0, 0}, {0, 0, 0}};
    mm_rgb_t c;

    /* 50% volume on a 12-pixel ring lights 6 pixels. */
    c = mm_render_pixel(&l, 50, 5, 12, 0, 0);
    CHECK(c.r > 0);
    c = mm_render_pixel(&l, 50, 6, 12, 0, 0);
    CHECK(c.r == 0 && c.g == 0 && c.b == 0);

    /* Gradient endpoints at full volume. */
    c = mm_render_pixel(&l, 100, 0, 12, 0, 0);
    CHECK(c.r == 0);
    c = mm_render_pixel(&l, 100, 11, 12, 0, 0);
    CHECK(c.r == 255);

    /* 0% volume: all off. */
    c = mm_render_pixel(&l, 0, 0, 12, 0, 0);
    CHECK(c.r == 0);

    /* Idle overrides volume: ring lit even at 0%. */
    c = mm_render_pixel(&l, 0, 11, 12, 1000, 1);
    CHECK(c.r > 0);

    /* Pulse varies over time and never goes fully dark. */
    l.mode = MM_LIGHT_PULSE;
    mm_rgb_t p0 = mm_render_pixel(&l, 100, 11, 12, 0, 0);
    mm_rgb_t p1 = mm_render_pixel(&l, 100, 11, 12, 1200, 0);
    CHECK(p0.r != p1.r);
    CHECK(p0.r >= 50);

    /* Wave bounds and period. */
    CHECK(mm_wave(0, 5) == 0);
    CHECK(mm_wave(1200, 5) == 255); /* speed 5 -> 2400ms period, peak at half */

    /* Ring reversal. */
    CHECK(mm_pixel_index(0, 12, 0) == 0);
    CHECK(mm_pixel_index(0, 12, 1) == 11);

    /* Idle timeout. */
    CHECK(!mm_is_idle(&l, 29999));
    CHECK(mm_is_idle(&l, 30000));
    l.idle_timeout_s = 0;
    CHECK(!mm_is_idle(&l, 1000000));
}

static void test_animated_modes(void) {
    mm_lighting_t l = {MM_LIGHT_RAINBOW, 5, 2, {{255, 0, 0}, {0, 0, 255}}, MM_LIGHT_CAROUSEL, 30,
                       {0, 0, 0}, {0, 0, 0}};
    mm_rgb_t a, b;

    /* Hue wheel: primaries at the sector starts. */
    a = mm_hue(0);
    CHECK(a.r == 255 && a.g == 0 && a.b == 0);
    a = mm_hue(85);
    CHECK(a.g == 255 && a.r < 10 && a.b < 10);
    a = mm_hue(170);
    CHECK(a.b == 255 && a.r < 10 && a.g < 10);

    /* Rainbow ignores volume (lit at 0%) and spreads hues around the ring. */
    a = mm_render_pixel(&l, 0, 0, 8, 0, 0);
    b = mm_render_pixel(&l, 0, 4, 8, 0, 0);
    CHECK((a.r | a.g | a.b) != 0);
    CHECK(a.r != b.r || a.g != b.g || a.b != b.b);
    /* ...and rotates over time. */
    b = mm_render_pixel(&l, 0, 0, 8, 600, 0);
    CHECK(a.r != b.r || a.g != b.g || a.b != b.b);

    /* Carousel: min colour at the start, max colour half way round. */
    l.mode = MM_LIGHT_CAROUSEL;
    a = mm_render_pixel(&l, 0, 0, 8, 0, 0);
    CHECK(a.r == 255 && a.b == 0);
    a = mm_render_pixel(&l, 0, 4, 8, 0, 0);
    CHECK(a.r < 10 && a.b > 245);

    /* Idle may use the animated modes too. */
    l.mode = MM_LIGHT_STATIC;
    a = mm_render_pixel(&l, 0, 0, 8, 0, 1);
    CHECK(a.r == 255 && a.b == 0);
}

static void test_volume_gauge(void) {
    /* Main colours red; the gauge must use the separate volume colours. */
    mm_lighting_t l = {MM_LIGHT_RAINBOW, 5, 2, {{255, 0, 0}, {255, 0, 0}}, MM_LIGHT_PULSE, 30,
                       {0, 0, 0}, {255, 255, 255}};
    mm_rgb_t c;

    /* Level in q8 pixel units. */
    CHECK(mm_level_q8(0, 8) == 0);
    CHECK(mm_level_q8(100, 8) == 8 * 256);
    CHECK(mm_level_q8(50, 8) == 4 * 256);

    /* 4.5 pixels: 0..3 full, 4 half-lit, 5 off. Colours follow the gradient. */
    uint16_t lvl = 4 * 256 + 128;
    c = mm_render_gauge(&l, lvl, 3, 8);
    CHECK(c.r > 100 && c.g == c.r && c.b == c.r); /* grey ramp = volume colours */
    c = mm_render_gauge(&l, lvl, 7, 8);
    CHECK(c.r == 0);
    mm_rgb_t full = mm_render_gauge(&l, 8 * 256, 4, 8);
    c = mm_render_gauge(&l, lvl, 4, 8);
    CHECK(c.r > 0 && c.r < full.r);
    c = mm_render_gauge(&l, lvl, 5, 8);
    CHECK(c.r == 0 && c.g == 0 && c.b == 0);

    /* Fill semantics: whole ring Low at 0%, whole ring High at 100%, the
     * boundary LED blended. No LED is ever off. */
    mm_lighting_t fill = {MM_LIGHT_STATIC, 5, 2, {{0, 0, 0}, {0, 0, 0}}, MM_LIGHT_PULSE, 30,
                       {255, 0, 0}, {0, 0, 255}};
    for (uint8_t i = 0; i < 8; i++) {
        c = mm_render_gauge(&fill, 0, i, 8);
        CHECK(c.r == 255 && c.b == 0);
        c = mm_render_gauge(&fill, 8 * 256, i, 8);
        CHECK(c.r == 0 && c.b == 255);
    }
    c = mm_render_gauge(&fill, 2 * 256, 1, 8);   /* filled */
    CHECK(c.b == 255 && c.r == 0);
    c = mm_render_gauge(&fill, 2 * 256, 2, 8);   /* not reached */
    CHECK(c.r == 255 && c.b == 0);
    c = mm_render_gauge(&fill, 2 * 256 + 128, 2, 8); /* boundary: half way */
    CHECK(c.r > 100 && c.r < 155 && c.b > 100 && c.b < 155);

    /* Easing approaches the target and lands on it exactly. */
    uint16_t v = 0;
    uint8_t steps = 0;
    while (v != 2048 && steps < 100) { v = mm_ease_q8(v, 2048); steps++; }
    CHECK(v == 2048 && steps > 2 && steps < 40);
    while (v != 0 && steps < 200) { v = mm_ease_q8(v, 0); steps++; }
    CHECK(v == 0);
}

static void test_palette(void) {
    /* Three colours: red, green, blue. */
    mm_lighting_t l = {MM_LIGHT_STATIC, 5, 3, {{255, 0, 0}, {0, 255, 0}, {0, 0, 255}},
                       MM_LIGHT_PULSE, 30, {0, 0, 0}, {0, 0, 0}};
    mm_rgb_t c;

    /* Linear: endpoints and the middle stop are exact. */
    c = mm_palette_linear(&l, 0);
    CHECK(c.r == 255 && c.g == 0 && c.b == 0);
    c = mm_palette_linear(&l, 255);
    CHECK(c.b == 255 && c.r == 0 && c.g == 0);
    c = mm_palette_linear(&l, 128);
    CHECK(c.g > 250 && c.r < 5 && c.b < 5);

    /* Cyclic: thirds land on each colour and it wraps back to the first. */
    c = mm_palette_cyclic(&l, 0);
    CHECK(c.r == 255 && c.g == 0);
    c = mm_palette_cyclic(&l, 86);   /* 86 * 3 = 258 -> just past green */
    CHECK(c.g > 245 && c.r < 10);
    c = mm_palette_cyclic(&l, 171);  /* 171 * 3 = 513 -> just past blue */
    CHECK(c.b > 245 && c.g < 10);
    c = mm_palette_cyclic(&l, 250);  /* heading back to red */
    CHECK(c.r > 200 && c.b < 60);

    /* Full-volume static ring walks the whole palette. */
    c = mm_render_pixel(&l, 100, 0, 8, 0, 0);
    CHECK(c.r == 255 && c.g == 0);
    c = mm_render_pixel(&l, 100, 7, 8, 0, 0);
    CHECK(c.b == 255 && c.r == 0);

    /* Carousel spreads all three colours around the ring. */
    l.mode = MM_LIGHT_CAROUSEL;
    c = mm_render_pixel(&l, 0, 0, 6, 0, 0);
    CHECK(c.r == 255);
    c = mm_render_pixel(&l, 0, 2, 6, 0, 0);
    CHECK(c.g > 245);
    c = mm_render_pixel(&l, 0, 4, 6, 0, 0);
    CHECK(c.b > 245);

    /* A single colour is a solid ring. */
    l.color_count = 1;
    c = mm_palette_cyclic(&l, 200);
    CHECK(c.r == 255 && c.g == 0 && c.b == 0);
    c = mm_palette_linear(&l, 77);
    CHECK(c.r == 255 && c.g == 0 && c.b == 0);
}

int main(void) {
    test_crc();
    test_decode_host_frames();
    test_encode_device_frames();
    test_resync();
    test_rejects_wrong_type_or_length();
    test_lighting();
    test_animated_modes();
    test_volume_gauge();
    test_palette();
    printf("%d checks, %d failures\n", checks, failures);
    return failures ? 1 : 0;
}
